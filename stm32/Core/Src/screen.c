#include "screen.h"
#include "pin.h"
#include "stm32_handle.h"
LCD_CHANGE = 0;

static const uint8_t BitReverseTable256[] =
{
    0x00, 0x80, 0x40, 0xC0, 0x20, 0xA0, 0x60, 0xE0, 0x10, 0x90, 0x50, 0xD0, 0x30, 0xB0, 0x70, 0xF0,
    0x08, 0x88, 0x48, 0xC8, 0x28, 0xA8, 0x68, 0xE8, 0x18, 0x98, 0x58, 0xD8, 0x38, 0xB8, 0x78, 0xF8,
    0x04, 0x84, 0x44, 0xC4, 0x24, 0xA4, 0x64, 0xE4, 0x14, 0x94, 0x54, 0xD4, 0x34, 0xB4, 0x74, 0xF4,
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    0x0F, 0x8F, 0x4F, 0xCF, 0x2F, 0xAF, 0x6F, 0xEF, 0x1F, 0x9F, 0x5F, 0xDF, 0x3F, 0xBF, 0x7F, 0xFF
};

inline void LcdCmdEnable()
{
	HAL_GPIO_WritePin(SCS_GPIO_Port, SCS_Pin, GPIO_PIN_SET);
}

inline void LcdCmdDisable()
{
	HAL_GPIO_WritePin(SCS_GPIO_Port, SCS_Pin, GPIO_PIN_RESET);
}

 void LcdDispEnable()
{
	HAL_GPIO_WritePin(DISP_GPIO_Port, DISP_Pin, GPIO_PIN_SET);
}

 void LcdDispDisable()
{
	HAL_GPIO_WritePin(DISP_GPIO_Port, DISP_Pin, GPIO_PIN_RESET);
}

void ClearBuff()
{
	for(uint8_t line = 0; line < LCD_DISP_BUFF_HEIGHT; line++) {
		for(uint8_t row = 0; row < LCD_DISP_BUFF_WIDTH; row++) {
			LCD_BUFF[line][row] = 0;
		}
	}
}

void ClearLCD()
{
	LcdCmdEnable();
	HAL_SPI_Transmit(&hspi2, &LCD_CMD_CLEAR, 1, 0);
	HAL_SPI_Transmit(&hspi2, &LCD_CMD_NOP, 1, 0);
	HAL_Delay(1);
	LcdCmdDisable();
}

void OutputBuff()
{
	LcdCmdEnable();
	HAL_SPI_Transmit(&hspi2, &LCD_CMD_UPDATE, 1, HAL_MAX_DELAY);
	for(uint8_t line = 0; line < LCD_DISP_BUFF_HEIGHT; line++) {
		uint8_t tmp = LCD_DISP_BUFF_HEIGHT - line;
		HAL_SPI_Transmit(&hspi2, &tmp, 1, 0);
		for(int8_t row = 49; row != -1; row--) {
			tmp = ~LCD_BUFF[line][row];
  		HAL_SPI_Transmit(&hspi2, &tmp, 1, HAL_MAX_DELAY);
		}
  	HAL_SPI_Transmit(&hspi2, &LCD_CMD_NOP, 1, HAL_MAX_DELAY);
	}
	HAL_SPI_Transmit(&hspi2, &LCD_CMD_NOP, 1, HAL_MAX_DELAY);
	HAL_SPI_Transmit(&hspi2, &LCD_CMD_NOP, 1, HAL_MAX_DELAY);
	HAL_Delay(1);
	LcdCmdDisable();
	LCD_CHANGE = 0;
}

void LCDSetBuff(const uint8_t* buff, uint8_t bytesPreLine, uint8_t x, uint8_t y, uint8_t height, uint8_t width, uint8_t reverbyte)
{
	// uint8_t bytes_width = (width / 8) > bytesPreLine ? bytesPreLine : (width / 8);
	// for (uint8_t curY = y, remain_height = height; remain_height != 0; curY++, remain_height--) {
	// 	for (uint8_t curX = x; curX < bytes_width; curX++) {
	// 		if (reverbyte != 0) {
	// 			LCD_BUFF[curY][curX] = BitReverseTable256[buff[curY*bytesPreLine + curX]];
	// 		} else {
	// 		    LCD_BUFF[curY][curX] = buff[curY*bytesPreLine + curX];
	// 		}
	// 	}
	// }
	// enlarge 3 times
	for (uint8_t y = 0; y < 48; y ++) {
		uint8_t orig_y = y / 3;
		for (uint8_t x = 0; x < 50; x++) {
			uint8_t c = 0;
			for (uint8_t pos = 0; pos < 8; pos++) {
				uint8_t poss = (8*x + pos)/3;
				uint8_t coresponseByte = BitReverseTable256[buff[orig_y * bytesPreLine + (poss >> 3)]];
				if ((coresponseByte & (1 << (7 - (poss&7)))) != 0) {
					c |= (1 << (7 - pos));
				} 
			}
			LCD_BUFF[y][x] = c;
		}
	}
	LCD_CHANGE = 1;
}
